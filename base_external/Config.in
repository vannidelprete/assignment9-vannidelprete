## base_external/Config.in
```kconfig
source "$BR2_EXTERNAL_AESD_ASSIGNMENTS_PATH/package/aesd-assignments/Config.in"
source "$BR2_EXTERNAL_AESD_ASSIGNMENTS_PATH/package/ldd/Config.in"
```

## base_external/package/ldd/Config.in
```kconfig
config BR2_PACKAGE_LDD
	bool "ldd"
	help
	  LDD3 kernel modules (scull and misc-modules).
```
